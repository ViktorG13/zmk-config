#define ZMK_BEHAVIORS_OMIT_KT

#include <behaviors.dtsi>

/{
    keymap = {
        compatible = "zmk,keymap"

        base {
            display-name = "base";
            bindings = "";
        };

    }
}